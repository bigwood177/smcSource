;  INVOIC / COP 
;
;		INVOICES PRINT 
;
; new ordlin key mod: lordno/ldept/litmno/ldescr krf=3

RECORD	D_STUFF
	D_IN	,D8		;DATE-IN, ANY FORMAT
	D_OUT	,D6		;RETURN VALUE MMDDYY
	D_OUTR	,D8		;RETURN VALUE CCYYMMDD
	D_FMT	,A10		;RETURN VALUE MM/DD/CCYY
	D_SW	,A2		;"99" = DATE CONVERSION ERROR


.DEFINE	HDR_LINES,	28
.DEFINE MID_LINES,	51
.DEFINE END_LINES,	43

;;;;;;;;;;;;;;;;;;;;;;;;;;;;;;;;;;;;;;;;;;;;;;;;;;;;;;;
	.INCLUDE 'DEF:HPSUB.DEF'
RECORD	EJECT
	E_CHAR	,A1		;<ESC>
		,A4,	"&l0H"	;page eject

RECORD	TOP_MARGIN
	TM_ESC	,A1
		,A4,	'&l0E'

RECORD	LEFT_MARGIN
	LM_ESC	,A1
		,A4,	'&a0L'
;;;;;;;;;;;;;;;;;;;;;;;;;;;;;;;;;;;;;;;;;;;;;;;;;;;;;;;

RECORD ORDHDR   	
		.INCLUDE 'DEF:RD044A.DEF'
RECORD ORDLIN
		.INCLUDE 'DEF:RD045A.DEF'
RECORD		,X		
		.INCLUDE 'DEF:RD045D.DEF'
RECORD CUSMAS
		.INCLUDE 'DEF:RD001A.DEF'
RECORD DUMCUS  ,X	
		.INCLUDE 'DEF:RD001B.DEF'
RECORD CUSIDX   	
		.INCLUDE 'DEF:RD002A.DEF'

RECORD	SALMAN
		.INCLUDE 'DEF:RD054A.DEF'

RECORD ARTERM
		.INCLUDE 'DEF:RD170A.DEF'
RECORD ARTCTL	,X
		.INCLUDE 'DEF:RD170B.DEF'

RECORD	COPTBL
	.INCLUDE 'DEF:RD182A.DEF'

RECORD PBUF
	PLINE	,A150
RECORD PARAM
		.INCLUDE 'DEF:PARAM2.DEF'

GLOBAL DUCK,INIT
		.INCLUDE 'DEF:RD175D.DEF'
ENDGLOBAL

RECORD	PAGE_OF
		,A*,	' PAGE '
	A_PAGOF	,A3
		,A4,	' OF '
	A_TPAGE	,A3

RECORD	CHANNEL
	CHN001	,D2
	CHN002	,D2
	CHN044	,D2
	CHN045	,D2
	CHN054	,D2
	CHN068	,D2
	CHN170	,D2
	CHN175	,D2
	CHN182	,D2

RECORD	WRK_DATE
	CC	,D2
	YY	,D2
	MM	,D2
	DD	,D2

RECORD
	MDAYS,	12D2,	31,28,31,30,31,30,31,31,30,31,30,31

RECORD	VARSX
	D_DAYS	,D2
	D_DATE	,D6
	D_30_DATE	,D6
	D_AMT	,D6
	D_LIN1	,A50
	D_LIN2	,A50
	D_LIN3	,A50
	DI	,D2

RECORD	VARS
	OPNOK	,D1
	PAGOF	,D3
	TPAGE	,D3
	DL_AMT	,D6
	DL_DATE	,D6
	DL1	,A62
	DL2	,A62
	IS_CMEMO	,D1
	MAXDUC	,D3,150
	QTY	,D5
	ITM	,A15
	DES	,A30
	PRC	,D7
	COMPA	,A15
	COMPB	,A15
RECORD
	SDUCRC	,150A28	;SUMMARIZED DUCT CONFIGURATIONS   (SEE DUCREC BELOW)
	LINSQF	,8D6	;SUMMARIZE LINER SQUARE FEET
RECORD DUCREC
	DUCCFG	,D7	;CONFIGURATION CODE
	DUCSQF	,D7	;SQ FEET OF MATERIAL
	DUCPND	,D7	;POUNDS OF MATERIAL
	DUCGPR	,D7	;GAUGE PRICE
RECORD ACCREC
	.INCLUDE 'DEF:ACCREC.DEF'
RECORD
	STRTNA	,A6
	ENDNA	,A6
RECORD	,X
	STRTNO	,D6
	ENDNO	,D6

RECORD	VARS2
	VL	,D3
	LROW	,D3
	NUM_LINES	,D4
	TOTAL_LINES	,D4
	PRINTED_LINES	,D4
	NUM_DUC		,D4
	SUM_ACC		,D4
	SUM_DUC		,D4
	REM		,D4
	NUM_MID	,D3
	SAVORD	,D6
	CONFIG	,D7	
	LFEED	,D2	
	ACCUOM	,A2	
	ORGSHV	,D5	
	ORGART	,D5	
	MAXLIN	,D2	
	N	,D2
	ADCNT2	,D4
	DECMAL	,D10
	LINCNT	,D2,	00
	X	,D2
	SPLFIL	,A14
	PGCNT	,D3,	000
	SWITCH	,D1
	ERRRET	,D1
	PAGENO	,D2
	MASK	,A12,'ZZZZ,ZZZ.XX-'
	MASK1	,A6,'ZZZZX-'
	MASK2	,A6,'ZXXXXX'
	MASK3	,A8,'XX/XX/XX'
	MASK4	,A9,'ZZZZZ.XXX'
	SAV001	,D5
	KEY   	,D6
	BSEND	,D5
	BSND2	,D5
	BSMID	,D5
	SRCCTL	,D1
	ENTRY	,A8	;ENTRY MUST BE DEFINED AS A MINIMUM OF 8 CHARACTERS
	INXCTL  ,D1
	CNGCTL	,D1
	WHATNO	,D1
	RPTNUM	,D3
	PRTTYP	,A1
	TAX	,D6
	CTR	,D2
	TRMS	,D4
	EXEPRC	,D8
	SAVINV	,D6
	INVDAT	,D8	;DATE8
	INVDAA	,A10
	TDATE	,D6
	TODAY	,D8
	TOTSAL	,D8
	STXCTL	,D1
	BLANKS	,A15
	V	,D1
	READ	,D1	,0
	WRITE	,D1	,1
	LOKCTL	,D1
	LPSW	,D1
	INIT	,20A3,	'JJM','TLE','LAM','DEG','JTH',
&			'DLH','JIM','SJM','CJM','BIL',
&			'MAW','PAT','BJZ','JPV','MJM',
&			'JEF','   ','   ','   ','   '
	RESTRT	,D1,	0
	REDFIL	,A14
	CLCTL	,D1
PROC
	XCALL TERID (V)
	XCALL RDATE (TDATE)
	XCALL DATE8(TDATE, D_OUT, TODAY, INVDAA, D_SW)

;;;	XCALL HP (14,hpDOTS, 0)
;;;	XCALL HP (14,hpTHICK,3)
;;;	XCALL ASCII (27,TM_ESC)
;;;	LM_ESC = TM_ESC
;;;	E_CHAR = TM_ESC

	XCALL OUTPT (1,1,2,'PRINT INVOICES',V)
	XCALL WATE (4,V)
	CALL OPENS
	IF (.NOT. OPNOK) 
		BEGIN
		CALL CLOSE
		GOTO ENDOFF
		END

DATE,
	XCALL OUTPT (6,20,2,'PLEASE ENTER INVOICE DATE:',V)
	XCALL INPUT (06,48,08,00,'D ',ENTRY,INXCTL,V)
	GO TO (DATE), INXCTL
	INVDAT = ENTRY (1,8)
	IF (ENTRY.EQ.BLANKS) INVDAT = TODAY
	XCALL DATE8(INVDAT, D_OUT, D_OUTR, INVDAA, D_SW)
	XCALL OUTPT (6,48,0,INVDAA,V)

	CNGCTL = 2
	XCALL ANYCN (CNGCTL,WHATNO)
	GO TO (DATE), CNGCTL
BEGIN,
	STRTNA =
	ENDNA =
	XCALL OUTPT (08,20,0,'PRINT WHOLE BATCH <Y> ',1)
	XCALL INPUT (08,42,01,00,'AE',ENTRY,INXCTL,1)
	GOTO (BEGIN,END2), INXCTL
	IF (ENTRY.EQ.BLANKS.OR.ENTRY.EQ.'Y') 
	BEGIN
	  XCALL OUTPT (08,20,0,'Y',1)
	  STRTNO = 0
	  ENDNO = 999999
	  RESTRT = 0
	  GOTO OPENLP
	END
	XCALL OUTPT (10,20,0,'REPRINT ONE ORDER: ',1)
	XCALL INPUT (10,40,06,00,'#E',ENTRY,INXCTL,1)
	GOTO (BEGIN,END2), INXCTL
	IF (ENTRY.EQ.BLANKS) 
	THEN XCALL OUTPT (10,40,0,'NO    ',1)
	ELSE BEGIN
	  STRTNO = ENTRY
	  ENDNO = ENTRY
	  RESTRT = 1		;PRINT ONE ORDER ONLY
	  GOTO OPENLP
	END
	XCALL OUTPT (12,20,0,'REPRINT TO END OF BATCH STARTING WITH ORDER: ',1)
	XCALL INPUT (12,65,06,00,'#E',ENTRY,INXCTL,1)
	GOTO (BEGIN,END2), INXCTL
	IF (ENTRY.EQ.BLANKS) 
	THEN XCALL OUTPT (12,65,0,'NO    ',1)
	ELSE BEGIN
	  STRTNO = ENTRY
	  ENDNO = 999999
	  RESTRT = 2		;PRINT REST OF BATCH STARTING WITH XXXXXX
	  GOTO OPENLP
	END
	GOTO BEGIN
OPENLP,
	LPSW = 5			;SPECIAL FORMS PRINTOUT

;;;	XCALL LPON (LPSW,SPLFIL)
;---------------------------
	XCALL HPON (LPSW,SPLFIL)
	XCALL HP (14,hpDOTS, 0)
	XCALL HP (14,hpTHICK,3)
	XCALL ASCII (27,TM_ESC)
	LM_ESC = TM_ESC
	E_CHAR = TM_ESC
;---------------------------

	IF (LPSW.EQ.0) XCALL PGCHN ('CP:UNPRBL',1)
	XCALL WATE (2,V)
	LOKCTL = 1
	XCALL IO (7,ORDHDR,1,READ,LOKCTL)
	IF (RESTRT.EQ.0) GOTO RDHDR
	IF (RESTRT.EQ.1) 
	BEGIN
	  OORDNO = STRTNO
	  GOTO RDHD2
	END
FIND,
	LOKCTL = 1
	XCALL IOS (7,ORDHDR,READ,LOKCTL)
	IF (ORDHDR.EQ.']]]]]]]]]]')
	BEGIN
	  XCALL MESAG ('CANNOT FIND STARTING ORDER NUMBER',1)
	  GOTO BEGIN
	END
	IF (OORDNO.EQ.STRTNO) GOTO RDHD2
	GOTO FIND
RDHDR,
	LOKCTL = 1
	XCALL IOS (7,ORDHDR,READ,LOKCTL)
	IF (LOKCTL.NE.0) GOTO ENDHDR
	IF (ORDHDR.EQ.']]]]]]]]]]') GOTO ENDHDR
	IF (RESTRT.EQ.1) GOTO ENDHDR
RDHD2,
	LOKCTL = 1
	XCALL ISIO (4,ORDHDR,OORDNO,READ,LOKCTL)
	IF (LOKCTL.EQ.2) GO TO ENDHDR
	IF (OFLAG.NE.1.AND.OFLAG.NE.2) GO TO RDHDR

;---------------------------------------------------------------------
	CALL COUNT_LINES			;compute # of pages
;---------------------------------------------------------------------

	ODSCAL =
	KEY = OCUSNO
	BSEND = SAV001
	XCALL SERCH (2,CUSIDX,KEY,1,6,BSEND,BSMID,SRCCTL,4,7,11,0,0,0,0)
	IF (SRCCTL.EQ.1) CALL NOCUST
	LOKCTL = 1
	IF (SRCCTL.EQ.0)
	BEGIN
	  XCALL IO (1,CUSMAS,IRC001,READ,LOKCTL)
	END

	CALL PRTHDR

	GO TO FNDITM


NOCUST,
	CUSMAS =
	RETURN

PRTHDR,	;;;;;;;;;;;;;;;;;;;;;;;;;;;;;;;;;;;;;;;;;;;;;;;;;;;;;;;;;

	WRITES (14, TOP_MARGIN)
	WRITES (14, LEFT_MARGIN)

	LINCNT =
	TOTSAL =
	PAGENO = 1

;try the logo...
;;;	XCALL HP (14,hpGRAPHIC,'SMC.HP', 100)

;company name & address...
	XCALL HP (14,hpFONT,hp8CPI+hpBOLD)
	IF (OSALE+OMISC+OTAX(1)+OTAX(2)+OTAX(3)+OFRGHT.LT.0)
	THEN	BEGIN
		IS_CMEMO = 1
		XCALL HP (14,hpPOS,1,24,0, "C R E D I T   M E M O")
		END
	ELSE	BEGIN
		IS_CMEMO = 0
		XCALL HP (14,hpPOS,1,24,0, "I N V O I C E")
		END

	XCALL HP (14, hpPOS,1,1,0, "SHEET")
	XCALL HP (14, hpPOS,2,1,0, "METAL")
	XCALL HP (14, hpPOS,3,1,0, "CONNECTORS, INC.")

	XCALL HP (14,hpFONT,hp12CPI+hpMEDIUM)	

	XCALL HP (14, hpPOS,4,1,0, "5850 MAIN STREET N. E.")
	XCALL HP (14, hpPOS,5,1,0, "MINNEAPOLIS,   MN 55432")
	XCALL HP (14,hpFONT,hpBOLD)
	XCALL HP (14, hpPOS,6,1,0, "612-572-0000  800-328-1966")
	XCALL HP (14, hpFONT,hpMEDIUM)
	XCALL HP (14,hpFONT,hpBOLD)
	XCALL HP (14, hpPOS,7,1,0, "FAX:612-572-1100")

	XCALL HP (14,hpFONT,hp12CPI+hpBOLD)

	XCALL HP (14, hpPOS,2,78,0,' INVOICE NO   ')
	XCALL HP (14, hpPOS,5,78,0,' INVOICE DATE ')

	PAGOF = 1
	A_PAGOF = PAGOF,'ZZX'
	A_TPAGE = TPAGE,'ZZX' [LEFT]
	XCALL HP (14,hpPOS,8,78,0,PAGE_OF)

	ENTRY(1,6) = OCUSNO,	'ZZZZZX' [LEFT]
	XCALL HP (14,hpPOS,13,8,0,'Acct #')
	XCALL HP (14,hpPOS,13,15,0,ENTRY(1,6))

	XCALL HP (14,hpPOS,14,1,0,'SOLD')
	XCALL HP (14,hpPOS,14,51,0,'SHIP')
	XCALL HP (14,hpPOS,15,2,0,'TO')
	XCALL HP (14,hpPOS,15,52,0,'TO')
		
	XCALL HP (14,hpFONT,hp10CPI+hpMEDIUM)
	XCALL HP (14, hpPOS,6,66,0,INVDAA)	;invoice date

	ENTRY(1,6) = OORDNO,	'ZZZZZX'
	XCALL HP (14, hpPOS,3,67,0,ENTRY(1,6))	;invoic #

	XCALL HP (14,hpFONT,hp12CPI+hpMEDIUM)

	XCALL HP (14,hpPOS,14,8,0,OCUSNM)
	XCALL HP (14,hpPOS,15,8,0,ADD1)
	XCALL HP (14,hpPOS,16,8,0,ADD2)
	CLEAR PLINE
	PLINE(1,15) = CITY
	PLINE(17,18) = STATE
	PLINE(20,29) = ZIP
	XCALL HP (14,hpPOS,17,8,0,PLINE(1,30))

	XCALL HP (14,hpPOS,14,58,0,OSHPNM)
	XCALL HP (14,hpPOS,15,58,0,OSHAD1)
	XCALL HP (14,hpPOS,16,58,0,OSHAD2)
	XCALL HP (14,hpPOS,17,58,0,OSHAD3)

	XCALL HP (14,hpFONT,hp10CPI+hpMEDIUM)
	XCALL HP (14, hpPOS,18,0, hpHLINE,164)	;
	XCALL HP (14, hpPOS,20,0, hpHLINE,164)	;

;;;	XCALL HP (14, hpPOS,18,0, hpHLINE,82)	;
;;;	XCALL HP (14, hpPOS,20,0, hpHLINE,82)	;
	

	XCALL HP (14,hpFONT,hp12CPI+hpBOLD)
;first header...
;;;	PLINE = 'Salesperson   Purchase Order #  Job Number        Ship Via
	PLINE = 'Salesperson     P.O. Number     Job Number        Ship Via
&         Date Shipped    Terms'
	XCALL HP (14,hpPOS,19,0,0,PLINE(1,%TRIM(PLINE)) )

	XCALL HP (14, hpPOS,20,13, hpVLINE,4)	
	XCALL HP (14, hpPOS,20,31, hpVLINE,4)	
	XCALL HP (14, hpPOS,20,43, hpVLINE,4)	
	XCALL HP (14, hpPOS,20,67, hpVLINE,4)	
	XCALL HP (14, hpPOS,20,79, hpVLINE,4)	

	
	XCALL HP (14,hpFONT,hp12CPI+hpMEDIUM)
	CLEAR PLINE
	XCALL IO (12, SALMAN, OSLMAN, READ, LOKCTL)
	IF (LOKCTL .NE. 0)
	THEN	PLINE (7,9) = INIT(OSLMAN)
	ELSE	PLINE (1,12) = SLSNM

	PLINE (17,26) = OPONO
	PLINE (33,42) = OJOBNO

	CALL GET_SCAC
	PLINE (46,60) = SC_NAME

;;; for orders in system prior to SCAC switch...
	IF (OSCAC.EQ.BLANKS .AND. OSHVIA.EQ.'1') OSCAC = 'WC'
	IF (OSCAC.NE.'WC')
	BEGIN
	  IF (OCLPPD.EQ.'C') PLINE (62,66) = '(COL)'
	  IF (OCLPPD.EQ.'D') PLINE (62,66) = '(COD)'
	  IF (OCLPPD.EQ.'P') PLINE (62,66) = '(PPD)'
	END

	XCALL DATE8(OSHDAT, D_OUT, D_OUTR, D_FMT, D_SW)
	PLINE (69,78) = D_FMT
;;;	PLINE (69,76) = OSHDAT, 'XX/XX/XX'

	SRCCTL = 2
	BSEND = ORGART
	XCALL SERCH (8,ARTERM,OTERMS,1,1,BSEND,BSMID,SRCCTL,4,2,7,0,0,0,0)
	IF (SRCCTL.EQ.1) ARTRDS = '*NF*'

	PLINE (81,95) = ARTRDS

	XCALL HP (14,hpPOS,21,0,0,PLINE)
	CLEAR PLINE

	MAXLIN = 52
;;;	VL = 28
	VL = 56
	LROW = 22

;-
; bottom of 1st page...
	IF (TPAGE .GT. 1)
		BEGIN
		XCALL HP (14,hpFONT,hp10CPI+hpBOLD)
		XCALL HP (14, hpPOS,52,1, hpHLINE,168)	;
		XCALL HP (14, hpPOS,60,1, hpHLINE,168)	;
		PLINE(1,12) = "Continued"
		XCALL HP (14,hpPOS,53,64,0,PLINE(1,12))
		XCALL HP (14,hpPOS,59,64,0,PLINE(1,12))
		CLEAR PLINE
		XCALL HP (14,hpFONT,hp12CPI+hpMEDIUM)
		XCALL HP (14, hpPOS,54,52, hpHLINE,88)	;
		XCALL HP (14, hpPOS,58,52, hpHLINE,88)	;
		XCALL HP (14, hpPOS,52,52, hpVLINE,16)	;
		XCALL HP (14, hpPOS,52,75, hpVLINE,16)	;
		END
;-----------------------------------------------------

	CALL BODY_HEADER		;1ST PAGE
	LINCNT = 25			;starting line for 1st page
	CLEAR PRINTED_LINES		;CLEAR FOR EACH NEW INVOICE

	RETURN
;-------------------------------------------------------------

FNDITM,
	LORDNO = OORDNO
	LINSEQ =
	LOKCTL = 1
	read (5, ordlin, lordno, krf=3)[err=line_1]
line_1,
;;;	XCALL ISIO (5,ORDLIN,LORDNO,READ,LOKCTL)
	IF (LOKCTL.EQ.3) GO TO GETDUC
	IF (LORDNO.NE.OORDNO) GO TO GETDUC
ITEMS,
	IF (LORDNO.EQ.OORDNO) CALL PRTLIN
	IF (LORDNO.GT.OORDNO) GO TO GETDUC
	LOKCTL = 1
	XCALL IOS (5,ORDLIN,READ,LOKCTL)
	IF (LOKCTL.EQ.2) GO TO GETDUC
	GO TO ITEMS
GETDUC,

	CALL CLEAR_SUM_ARRAYS

	FIND (6, DUCACC, OORDNO) [ERR=NXTDUC]
NXTDUC,
	LOKCTL = 1
	XCALL IOS (6,DUCACC,READ,LOKCTL)
	IF (LOKCTL.NE.0 .OR. DUCTOR.NE.OORDNO) GOTO ORDTOT
	CALL PRTDUC
	CALL SUMDUC
	GOTO NXTDUC
;----------------------------------------------------

SUMDUC,	;;;;;;;;;;;;;;;;;;;;;;;;;;;;;;;;;;;;;;;;;;;;;;;;;;;;;
	CONFIG(1,3) = GAUGE
	IF (DUTYPE.EQ.2.OR.DUTYPE.EQ.3) CONFIG(1,3) = THICK
	CONFIG(4,4) = DUTYPE
	CONFIG(5,5) = CAT
	CONFIG(6,6) = STY
	CONFIG(7,7) = SEAM

		; Check to see if the configuration has all ready 
		; been on this order
	I =
	DO BEGIN
	  INCR I
	  DUCREC = SDUCRC(I)
	END
	UNTIL (DUCCFG.EQ.CONFIG.OR.DUCCFG.EQ.0.OR.I.GE.MAXDUC)
	IF (I.GE.MAXDUC) GOTO BADCON

	DUCCFG = CONFIG
	DUCSQF = DUCSQF + SQFEET
	DUCPND = DUCPND + POUNDS
	DUCGPR = GPRICE
	SDUCRC(I) = DUCREC
	SUM_DUC = I		;# OF ARRAY ELEMENTS
	SUM_DUC = SUM_DUC + 1	;4-30-99 FOR LINFEED

	IF (LINER.GE.1.AND.LINER.LE.8.AND.LINER.NE.4)
&		LINSQF(LINER) = LINSQF(LINER) + SQFLIN

		;Summarize accessories

;;;	IF (ACC.EQ.2) GOTO NXTDUC
	IF (ACC.EQ.2) RETURN

	IF (SLIPS)
	BEGIN
	  QTY = SLIPS
	  ITM = SLPITM
	  PRC = SLPPRC
	  DES = SLPDES
	  CALL SUMACC
	END
	IF (DRIVES)
	BEGIN
	  QTY = DRIVES
	  ITM = DRVITM
	  PRC = DRVPRC
	  DES = DRVDES
	  CALL SUMACC
	END
	IF (TCORN)
	BEGIN
	  QTY = TCORN
	  ITM = CORITM
	  PRC = CORPRC
	  DES = CORDES
	  CALL SUMACC
	END
	IF (TNBQTY)
	BEGIN
	  QTY = TNBQTY
	  ITM = TNBITM
	  PRC = TNBPRC
	  DES = TNBDES
	  CALL SUMACC
	END
	IF (TGAQTY)
	BEGIN
	  QTY = TGAQTY
	  ITM = TGAITM
	  PRC = TGAPRC
	  DES = TGADES
	  CALL SUMACC
	END
	IF (TCLQTY)
	BEGIN
	  QTY = TCLQTY
	  ITM = TCLITM
	  PRC = TCLPRC
	  DES = TCLDES
	  CALL SUMACC
	END
	IF (TBAQTY)
	BEGIN
	  QTY = (JOINT * 4)
	  ITM = TBAITM
	  ITM (10,13) = SIZE1,'ZZX"'
	  PRC = TBAPRC
	  DES = TBADES
	  CALL SUMACC
	  QTY = (JOINT * 4)
	  ITM = TBAITM
	  ITM (10,13) = SIZE2,'ZZX"'
	  PRC = TBAPRC
	  DES = TBADES
	  CALL SUMACC
	END
	IF (TBNQTY)
	BEGIN
	  QTY = TBNQTY
	  ITM = TBNITM
	  PRC = TBNPRC
	  DES = TBNDES
	  CALL SUMACC
	END

	RETURN
;----------------------------------

SUMACC,
		; Check to see if the accessories have all ready 
		; been on this order
	I =
	DO BEGIN
	  INCR I
	  ACCREC = SACCRC(I)
	END
	UNTIL (ACCITM.EQ.ITM.OR.ACCITM.EQ.BLANKS.OR.I.GE.MAXACC)
	IF (I.GE.MAXACC) GOTO BADACC

	ACCQTY = ACCQTY + QTY
	ACCITM = ITM
	ACCPRC = PRC
	ACCDES = DES
	SACCRC(I) = ACCREC
	SUM_ACC = I		;# OF ARRAY ELEMENTS
	RETURN
;----------------------------------------------

BADCON,
	XCALL LINFD (1)
	INCR LINCNT
	PLINE (32,60) = 'DUCT INFORMATION IS '	
	CALL PRINT
	GOTO ERRMSG
BADACC,
	XCALL LINFD (1)
	INCR LINCNT
	PLINE (32,60) = 'ACCESSORY INFORMATION IS'	
	CALL PRINT
ERRMSG,
	PLINE (32,60) = 'PRESENTLY OVERFLOWING THE'
	CALL PRINT
	PLINE (32,60) = 'ARRAY BOUNDARIES.  PLEASE CALL'
	CALL PRINT
	PLINE (32,60) = 'SOFTWARE SUPPORT TO CORRECT THE'
	CALL PRINT
	PLINE (32,60) = 'PROBLEM'
	CALL PRINT
	GOTO ORDTOT

PRTLIN,	;;;;;;;;;;;;;;;;;;;;;;;;;;;;;;;;;;;;;;;;;;;;;;;;;;;;;;;;;;
	IF (LTYPE .EQ. 'M') RETURN
	IF (LDESCR.EQ.']]]CANCEL') RETURN
	IF (LFLAG.EQ.0) RETURN
;;;	IF (LINCNT+1.GT.MAXLIN) CALL NXTPAG
	IF (LINCNT.GT.MAXLIN) CALL NXTPAG
	PLINE (18,32) = LITMNO
	IF (LDAMPR) PLINE(27,32) = 'Damper'		;12-2-98 ssq

	IF (LITMNO.EQ.'???') PLINE (18,32) = '***'
	IF (LITMNO.EQ.'M              ') PLINE (18,32) =
	PLINE (35,64) = LDESCR
	IF ( LITMNO.NE.'M              ' )
	BEGIN
	  PLINE (1,7) = LQTYOR, 'ZZ,ZZX-'
	  PLINE (9,17) = LQTYSH, 'ZZZ,ZZX-'
	  PLINE (69,77) = LPRICE,	'Z,ZZZ.XXX'
	  PLINE (80,81) = LUOFM
	  DECMAL = ((LQTYSH*LPRICE) - (LDISC*LQTYSH*LPRICE)#2)#1
	  EXEPRC = DECMAL - ((DECMAL*LODISC)#2)
	  PLINE (85,94) = EXEPRC, MASK
	  TOTSAL = TOTSAL + EXEPRC
	END
	CALL PRINT
	LFLAG = 2
	LOKCTL = 1
	XCALL ISIO (5,ORDLIN,ORDKEY,WRITE,LOKCTL)
	RETURN
;-----------------------------------------------------------

PRTDUC,	;;;;;;;;;;;;;;;;;;;;;;;;;;;;;;;;;;;;;;;;;
	;;; Print duct record
	;;;;;;;;;;;;;;;;;;;;;;;;;;;;;;;;;;;;;;;;;
	IF ((LINCNT+2).GT.MAXLIN) CALL NXTPAG
;;;	IF ((LINCNT+3).GT.MAXLIN) CALL NXTPAG
;;;	IF (LINCNT.GT.MAXLIN) CALL NXTPAG
	INCR LINCNT
	INCR PRINTED_LINES

	PLINE (1,6) = JOINT,MASK1
	PLINE (8,9) = 'JT'
	IF (DUTYPE.NE.2.AND.DUTYPE.NE.3)
	BEGIN
	  PLINE (35,36) = GAUGE,'XX'
	  PLINE (37,38) = 'GA'
	END
	IF (DUTYPE.EQ.2.OR.DUTYPE.EQ.3)
	BEGIN
	  PLINE (35,38) = THICK,'.XXX'
	END
	PLINE (18,19) = SIZE1,'ZZX'
	PLINE (20,20) = 'X'
	PLINE (21,23) = SIZE2,'ZZX'
	PLINE (24,24) = 'X'
	PLINE (25,26) = SIZE3,'ZX'

	PLINE (40,43) = DTYPE(DUTYPE)
	PLINE (45,50) = DCAT(CAT)
	PLINE (52,54) = DSTY(STY)
	PLINE (56,58) = DSEAM(SEAM)
	IF (SEAL.EQ.1) PLINE (60,63) = 'SEAL'
	PLINE (69,77) = GPRICE,MASK4
	DECMAL = ( POUNDS * GPRICE ) # 1
	PLINE (80,81) = 'LB'
	PLINE (85,94) = DECMAL,MASK
	TOTSAL = TOTSAL + DECMAL		;DUCT
	CALL PRINT

	PLINE (  1,6  ) = POUNDS,MASK1
	PLINE (  8,8  ) = '#'
	PLINE ( 40,46 ) = DLINER( LINER )
	IF (SQFLIN.NE.0) 
	BEGIN
	  PLINE ( 16,21 ) = SQFLIN,MASK1
	  PLINE ( 24,28 ) = 'SQ FT'
	  PLINE ( 47,51 ) = 'LINR '
 	END
	PLINE ( 52,64 ) = LOCAT
	PLINE ( 69,77 ) = LINPRC,MASK4
	PLINE ( 80,81 ) = 'SF'
	DECMAL = ( LINPRC * SQFLIN ) # 1
	PLINE (85,94) = DECMAL,MASK
	TOTSAL = TOTSAL + DECMAL		;LINER
	CALL PRINT

	IF (ACC.EQ.1)
&	DECMAL = ( ( SLIPS  * SLPPRC ) # 1 ) +
&		 ( ( DRIVES * DRVPRC ) # 1 ) +
&		 ( ( TCORN  * CORPRC ) # 1 ) +
&		 ( ( TNBQTY * TNBPRC ) # 1 ) +
&		 ( ( TGAQTY * TGAPRC ) # 1 ) +
&		 ( ( TCLQTY * TCLPRC ) # 1 ) +
&		 ( ( TBAQTY * TBAPRC ) # 1 ) +
&		 ( ( TBNQTY * TBNPRC ) # 1 )
	FLG175 = 2
	LOKCTL = 1
	XCALL ISIO (6,DUCACC,KEY175,WRITE,LOKCTL)

	RETURN
;-------------------------------------------------------

PRTSAC,
		; Print summarized accessories from this order
;
;	BUBBLE SORT ACCREC ARRAY
;
	FOR I FROM 1 THRU MAXACC
	  BEGIN
	  ACCREC = SACCRC(I)
	  IF (ACCQTY.EQ.0) GOTO PRTSA2
	  COMPA = ACCITM
	  ACCREC = SACCRC(I+1)
	  IF (ACCQTY.EQ.0) GOTO PRTSA2
	  COMPB = ACCITM
	  IF (COMPA.GT.COMPB)
	  BEGIN
	    SACCRC(I+1) = SACCRC(I)
	    SACCRC(I) = ACCREC
	    I = I - 2
	    IF (I.LT.0) I = 0
	  END
	END
	PLINE (32,60) = 'BUBBLE SORT ACC ARRAY'	
	CALL PRINT
	GOTO BADACC
PRTSA2,
	FOR I FROM 1 THRU MAXACC
	  BEGIN
	  ACCREC = SACCRC(I)
	  IF (ACCITM.EQ.BLANKS) RETURN
;;;	  IF ((LINCNT+1).GT.MAXLIN) CALL NXTPAG
	  IF ((LINCNT).GT.MAXLIN) CALL NXTPAG
	  PLINE (1,6) = ACCQTY,MASK1
	  PLINE (18,32) = ACCITM
	  PLINE (35,64) = ACCDES
	  ACCUOM = 'EA'
	  IF (ACCITM(4,6).EQ.'GS ') ACCUOM = 'FT'
	  IF (ACCITM(4,6).EQ.'BAR') 
	  BEGIN
	    ACCUOM = 'IN'
	    DECMAL = ACCITM(10,12)
	    ACCQTY = ACCQTY * DECMAL
	  END
	  PLINE (80,81) = ACCUOM
	  PLINE (69,77) = ACCPRC,MASK4
	  DECMAL = (ACCQTY * ACCPRC) #1
	  PLINE (85,94) = DECMAL,MASK
	  TOTSAL = TOTSAL + DECMAL		;ACCESSORIES
	  CALL PRINT
	  SACCRC(I) =
	END
	IF (I.GE.MAXACC) GOTO BADACC
	RETURN
;--------------------------------------------------------------

PRTSDU,
		;Print summarized duct from this order
;;;	IF ((LINCNT+1).GT.MAXLIN) CALL NXTPAG
	IF ((LINCNT).GT.MAXLIN) CALL NXTPAG
	INCR LINCNT
	FOR I FROM 1 THRU MAXDUC
	  BEGIN
	  DUCREC = SDUCRC(I)
	  IF (DUCCFG.EQ.0) GOTO PRTSD2
;;;	  IF ((LINCNT+1).GT.MAXLIN) CALL NXTPAG
	  IF ((LINCNT).GT.MAXLIN) CALL NXTPAG
	  PLINE (1,6) = DUCPND,MASK1
	  PLINE (7,7) = '#'
	  PLINE (18,19) = DUCCFG(1,3),'XX'
	  PLINE (21,22) = 'GA'
	  IF (DUCCFG(4,4).EQ.2.OR.DUCCFG(4,4).EQ.3)
	  BEGIN
	    PLINE (18,22) = DUCCFG(1,3),'.XXX'
	  END
	  PLINE (35,38) = DTYPE(DUCCFG(4,4))
	  PLINE (40,45) = DCAT(DUCCFG(5,5))
	  PLINE (47,49) = DSTY(DUCCFG(6,6))
	  PLINE (51,53) = DSEAM(DUCCFG(7,7))
	  CALL PRINT
	  SDUCRC(I) =
	END
PRTSD2,
	FOR I FROM 1 THRU 6
	  BEGIN
	  IF (LINSQF(I).NE.0)
	  BEGIN
;;;	    IF ((LINCNT+1).GT.MAXLIN) CALL NXTPAG
	    IF ((LINCNT).GT.MAXLIN) CALL NXTPAG
	    PLINE (1,6) = LINSQF(I),MASK1
	    PLINE (18,22) = 'SQ FT'
	    PLINE (40,46) = DLINER(I)
	    PLINE (47,51) = ' LINER'
	    CALL PRINT
	    LINSQF(I) =
	  END
	END
	RETURN	
;-----------------------------------------------

PRINT,
	XCALL HP(14, hpPOS, LINCNT, 0, 0, PLINE(1,%TRIM(PLINE)) )
	CLEAR PLINE
	INCR PRINTED_LINES	
	INCR LINCNT

;;;	XCALL LPOUT (LINCNT,PGCNT,PBUF,'NO TITLE','NO HDR',' ',' ',
;;;&	'NO LEGEND',' ',' ',0,85,85,0,LPSW,RPTNUM,PRTTYP)
	RETURN
;--------------------------------------------------

ORDTOT,
	CALL PRTSAC
	CALL PRTSDU

BOTTOM_LAST,	;;;;;;;;;;;;;;;;;;;;;;;;;;;;;;;;;;;;;;;;;;
	XCALL HP (14,hpFONT,hp10CPI+hpBOLD)
	XCALL HP (14, hpPOS,52,1, hpHLINE,168)	;
	XCALL HP (14, hpPOS,60,1, hpHLINE,168)	;

	XCALL HP (14,hpFONT,hp12CPI+hpMEDIUM)
	XCALL HP (14, hpPOS,54,52, hpHLINE,88)	;
	XCALL HP (14, hpPOS,58,52, hpHLINE,88)	;

	XCALL HP (14,hpFONT,hpBOLD)

	CALL DISPLA_DISC

	XCALL HP (14, hpPOS,55,3,0,D_LIN1(1,%TRIM(D_LIN1)))
	XCALL HP (14, hpPOS,56,3,0,D_LIN2(1,%TRIM(D_LIN2)))
	XCALL HP (14, hpPOS,57,3,0,D_LIN3(1,%TRIM(D_LIN3)))

	XCALL HP (14,hpFONT,hpMEDIUM)

	XCALL HP (14, hpPOS,53,58,0,'SALE AMOUNT')	;
	XCALL HP (14, hpPOS,55,53,0, OTAXFL)
	XCALL HP (14, hpPOS,55,58,0,'STATE SALES TAX')	;
	XCALL HP (14, hpPOS,56,58,0,'CITY SALES TAX')	;
	XCALL HP (14, hpPOS,57,58,0,'SHIPPING CHARGES')	;
	XCALL HP (14,hpFONT,hpBOLD)
	XCALL HP (14, hpPOS,59,53,0,'TOTAL DUE BY ')	;
	PLINE(1,8) = D_30_DATE,	'ZX/XX/XX'
	XCALL HP (14, hpPOS,59,66,0,PLINE(1,8))	;
	CLEAR PLINE
	
	XCALL HP (14, hpPOS,52,52, hpVLINE,16)	;
	XCALL HP (14, hpPOS,52,75, hpVLINE,16)	;

;test lines...

	XCALL HP (14,hpFONT,hp10CPI+hpMEDIUM)

	PLINE(1,12) = TOTSAL,MASK
	XCALL HP (14,hpPOS,53,64,0,PLINE(1,12))

 	PLINE(1,12) = OTAX(1),MASK
	XCALL HP (14,hpPOS,55,64,0,PLINE(1,12))

	PLINE(1,12) = (OTAX(2)+OTAX(3)) ,MASK
	XCALL HP (14,hpPOS,56,64,0,PLINE(1,12))

	PLINE(1,12) = OFRGHT ,MASK
	XCALL HP (14,hpPOS,57,64,0,PLINE(1,12))

	TAX = OTAX(1) + OTAX(2) + OTAX(3)
	DECMAL = TOTSAL + OMISC + TAX + OFRGHT
	PLINE(1,12) = DECMAL ,MASK
	XCALL HP (14,hpFONT,hpBOLD)
	XCALL HP (14,hpPOS,59,64,0,PLINE(1,12))

	OINVNO = oordno
	OINVDT = INVDAT
	OFLAG = 2		;OFLAG = 2 / INVOICE PRINTED
	OSALE = TOTSAL
	LOKCTL = 1
	XCALL ISIO (4,ORDHDR,OORDNO,WRITE,LOKCTL)
;;;	XCALL LINFD (0)
	CALL PAGE_FEED
	GO TO RDHDR
	RETURN
;---------------------------------------------------------

;-
DISPLA_DISC,	;;;;;;;;;;;;;;;;;;;;;;;;;;;;;;;;;;;;;;;;
	CLEAR D_LIN1, D_LIN2, D_LIN3

	D_DAYS = 30
	CALL MAKE_D_DATE
	D_30_DATE = D_DATE

	USING DSCODE SELECT
	(0),	BEGIN
		D_LIN1 = ocomnt(1)
		D_LIN2 = ocomnt(2)
		END
	(1),	BEGIN
		D_DAYS = 15
		CALL MAKE_D_DATE
		IF (DSAMT .EQ. 0)
		THEN	D_AMT = (2*OSALE)#2
		ELSE	D_AMT = DSAMT

		D_LIN1 = "A discount of $"
		D_LIN1(16,23) = D_AMT, 'ZZZX.XX' [LEFT]
		DI = %TRIM(D_LIN1)
		D_LIN1(DI+1, 50) = " may be taken only if"
		
		D_LIN2 = "payment is received and in our office by"
		D_LIN2(42,49) = D_DATE, 'ZX/XX/XX' [LEFT]
		END
	(2),	BEGIN
		D_LIN1 = "Payment must be received in our office by"
		D_LIN1(43,50) = D_30_DATE, 'ZX/XX/XX' [LEFT]

		D_LIN2 = "for discounted delivered prices to be valid."
		END
	(3),	BEGIN
		D_LIN1 = "Payment must be received in our office by"
		D_LIN1(43,50) = D_30_DATE, 'ZX/XX/XX' [LEFT]

		D_LIN2 = "for discount to apply."
		END
	(4),	BEGIN
		D_LIN1 = "A discount of $"
		D_LIN1(16,23) = DSAMT, 'ZZZX.XX' [LEFT]
		DI = %TRIM(D_LIN1)
		D_LIN1(DI+1, 50) = " and the freight charges"

		D_LIN2 = "may be deducted only if this invoice"
		
		D_LIN3 = "is paid and in our office by"
		D_LIN3(30,37) = D_30_DATE, 'ZX/XX/XX' [LEFT]
		END
	(5),	BEGIN
		D_DAYS = 30
		CALL MAKE_D_DATE
		IF (DSAMT .EQ. 0)
		THEN	D_AMT = (2*OSALE)#2
		ELSE	D_AMT = DSAMT

		D_LIN1 = "A discount of $"
		D_LIN1(16,23) = D_AMT, 'ZZZX.XX' [LEFT]
		DI = %TRIM(D_LIN1)
		D_LIN1(DI+1, 50) = " may be taken only if"
		
		D_LIN2 = "payment is received and in our office by"
		D_LIN2(42,49) = D_DATE, 'ZX/XX/XX' [LEFT]
		END
		
	ENDUSING

;;;		XCALL OUTPT (21,28,1,D_LIN1(1,%TRIM(D_LIN1)),1)
;;;		XCALL OUTPT (22,28,1,D_LIN2(1,%TRIM(D_LIN2)),1)
;;;		XCALL OUTPT (23,28,1,D_LIN3(1,%TRIM(D_LIN3)),1)
	RETURN
;-------------------------------------------------------
MAKE_D_DATE,
	WRK_DATE = INVDAT
	DD = DD + D_DAYS
	IF (DD .GT. MDAYS(MM))
	   BEGIN
	   DD = DD - MDAYS(MM)
	   MM = MM + 1
	   IF (MM .GT. 12)
	      BEGIN
	      YY = YY + 1
	      MM = 1
	      END
	   END
	XCALL DATE8(WRK_DATE, D_DATE, D_OUTR, D_FMT, D_SW)
;;;	D_DATE = WRK_DATE
	RETURN
;-------------------------------------------------------
ENDUP,
	CALL PAGE_FEED
	CLOSE 14
	LPQUE('TEST.SPL')
	RETURN

PAGE_FEED,
	DISPLAY (14, EJECT)
;;;	XCALL HP (14,hpFLUSH)
;;;	WRITES (14, TOP_MARGIN)
;;;	WRITES (14, LEFT_MARGIN)
	RETURN
;-
;---------------------------------------------------------

ENDHDR,
;;;	PLINE(1,2) = ' @' 
;;;	XCALL ASCII (27,PLINE(1,1))
;;;	DISPLAY (14,PLINE(1,2))
	PGCNT = -9		;SSQ 6-10-98 no final form feed...

;;;	XCALL LPOFF (LPSW,SPLFIL,PGCNT)
	XCALL HPOFF (LPSW,SPLFIL,PGCNT)

	GOTO BEGIN
END2,
	XCALL OUTPT (6,20,2,'ARE ALL INVOICES OK <N> ? ',V)
	XCALL INPUT (06,46,01,01,'YN',ENTRY,INXCTL,V)
	IF (ENTRY.EQ.' ') INXCTL = 2
	GO TO (END3,END4), INXCTL	;1=YES   2=NO
	GOTO END2
END3,
	XCALL WATE(4,V)
	CALL RBLIDX	;;;ADDED 6/23/93 TO REBUILD INDEX AFTER INVOICES PRINT
			;	AND PICKUP ANY ADDED INVOICES
	CALL CLOSE 

;;;STOP
	XCALL PGCHN ('CP:POSTAR',1)

;;;
;	ADDED 6/23/93 TO REBUILD TEMP INDEX AFTER ALL INVOICES ARE OK
;;;
RBLIDX,
	XCALL OUTPT (2,1,1,'REBUILD ALPHA BILLING INDEX',1)
	CLOSE 7

;;;	open (7,o,'smc:invoic.wrk')	;ssq 10-14-98
	OPEN (7, O, REDFIL)		;SSQ 6-25-99

	ORDHDR =
	LOKCTL = 1
	XCALL IOS (7,ORDHDR,WRITE,LOKCTL)
	LOKCTL = 1
	XCALL ISIO (4,ORDHDR,OORDNO,READ,LOKCTL)
RBLP2,
	IF (OFLAG.GE.2)
	BEGIN
	  LOKCTL = 1
	  XCALL IOS (7,ORDHDR,WRITE,LOKCTL)
	END
	LOKCTL = 1
	XCALL IOS (4,ORDHDR,READ,LOKCTL)
	IF (LOKCTL.EQ.0) GOTO RBLP2
	ORDHDR = ']]]]]]]]]]]]]]]]]]]]]]]]]]]]]]]]]]]]]]]]]]]]]]]'
	LOKCTL = 1
	XCALL IOS (7,ORDHDR,WRITE,LOKCTL)
	CLOSE 7
	XCALL OUTPT (2,1,0,'SORT    ALPHA BILLING INDEX',1)
;;;	redfil = "smc:invoic.wrk"
	SORT (INPUT=REDFIL,RECORD=ORDHDR,KEY=(OCUSNO,OORDNO))
	XCALL OUTPT (0,0,0,' ... COMPLETED',1)
	RETURN
;
;;;
;
END4,
	XCALL OUTPT (7,20,0,'END OFF FOR FURTHER CHANGES ?',V)
	XCALL INPUT (07,51,01,01,'YN',ENTRY,INXCTL,V)
	GO TO (END5,BEGIN), INXCTL
END5,
	XCALL WATE(3,V)
	XCALL OUTPT (2,1,1,'UNSET ORDER HEADER INVOICE FLAG',1)
	OORDNO = 0
	LOKCTL = 1
	XCALL ISIO (4,ORDHDR,OORDNO,READ,LOKCTL)
	IF (LOKCTL.EQ.3) GO TO END6
	GO TO UNSET1
UNSET,
	LOKCTL = 1
	XCALL IOS (4,ORDHDR,READ,LOKCTL)
	IF (LOKCTL.EQ.2) GO TO END6
UNSET1,
	IF (OFLAG.NE.2) GO TO UNSET
	OFLAG = 1
	LOKCTL = 1
	XCALL ISIO (4,ORDHDR,OORDNO,WRITE,LOKCTL)
	GO TO UNSET
END6,
	CLOSE 4
	XCALL OUTPT (2,1,1,'UNSET ORDER LINE INVOICE FLAG',1)
	ORDKEY =
	LOKCTL = 1
	XCALL ISIO (5,ORDLIN,ORDKEY,READ,LOKCTL)
	IF (LOKCTL.EQ.3) GO TO END7
	GO TO UNSTL1
UNSETL,
	LOKCTL = 1
	XCALL IOS (5,ORDLIN,READ,LOKCTL)
	IF (LOKCTL.NE.0) GO TO END7
UNSTL1,
	IF (LFLAG.NE.2) GO TO UNSETL
	LFLAG = 1
	LOKCTL = 1
	XCALL ISIO (5,ORDLIN,ORDKEY,WRITE,LOKCTL)
	GO TO UNSETL
END7,
	XCALL OUTPT (2,1,1,'UNSET DUCT ACCESSORY INVOICE FLAG',1)
UNSETD,
	LOKCTL = 1
	XCALL IOS (6,DUCACC,READ,LOKCTL)
	IF (LOKCTL.EQ.2) GO TO END8
UNSTD1,
	IF (FLG175.NE.2) GO TO UNSETD
	FLG175 = 1
	LOKCTL = 1
	XCALL ISIO (6,DUCACC,KEY175,WRITE,LOKCTL)
	GO TO UNSETD
END8,
	CLOSE 6
	XCALL OUTPT (2,1,1,'\',1)
	XCALL MESAG('INVOICES FROM THIS RUN NOT VALID',2)
	XCALL MOUNT ('REGULAR PAPER','PRINTER')
	XCALL FILES (10,'I',41,4)		; FILE # 41 -- ITMMAS
	XCALL FILES (8,'I',68,4)		; FILE # 68 -- TMPIDX
	XCALL PGCHN ('CP:UNPRBL',1)


ENDOFF,
	XCALL MESAG ('FILES IN USE, RUN CLRFIL AND TRY AGAIN',1)
	CALL CLOSE
	XCALL PGCHN ('CP:UNPRBL',1)

;======================================================

GET_SCAC,	;;;;;;;;;;;;;;;;;;;;;;;;;;;;;
		;;; COP TABLE SCAC LOOK-UP
		;;;;;;;;;;;;;;;;;;;;;;;;;;;;;
	CLEAR TBL_KEY
	TBLCOD = 'SC'
	TBLKEY = OSCAC
	XCALL ISIO (CHN182,COPTBL,TBL_KEY,READ,LOKCTL)
	IF (LOKCTL .NE. 0)
		BEGIN
		CLEAR COPTBL
		SC_NAME = "* NOT ON FILE *"
		END
	RETURN
;-----------------------------------------------------

COUNT_LINES,	;;;;;;;;;;;;;;;;;;;;;;;;;;;;;;;;;;;;;;
		;;; DETERMIN # OF PAGES ON INVOICE
		;;;;;;;;;;;;;;;;;;;;;;;;;;;;;;;;;;;;;

	SAVORD = OORDNO		;CURRENT ORDER #
	CLEAR NUM_LINES, NUM_DUC, SUM_ACC, SUM_DUC
	CALL CLEAR_SUM_ARRAYS

	LOKCTL = 1
	XCALL ISIO (5, ORDLIN, OORDNO, READ, LOKCTL)
	WHILE	(LORDNO.EQ.OORDNO .AND. LOKCTL.EQ.0)
		BEGIN
	;;;	INCR NUM_LINES
		IF(LTYPE.NE.'M')INCR NUM_LINES
		LOKCTL = 1
		XCALL IOS (5, ORDLIN, READ, LOKCTL)
		END

	LOKCTL = 1
	XCALL ISIO (6, DUCACC, OORDNO, READ, LOKCTL)
	WHILE	(DUCTOR.EQ.OORDNO .AND. LOKCTL.EQ.0)
		BEGIN
		INCR NUM_DUC
		CALL SUMDUC		;summarize duct and acc
		LOKCTL = 1
		XCALL IOS (6, DUCACC, READ, LOKCTL)
		END

	IF (SUM_DUC.GT.0) INCR SUM_DUC	;SSQ 6-25-99 (for linfeed)
	TOTAL_LINES = NUM_LINES + (3*NUM_DUC) + SUM_ACC + SUM_DUC

;emulate the way the invoice will be printed to
;compute the number of pages...

	CLEAR PRINTED_LINES
	TPAGE = 1
	LINCNT = 25		;1ST PAGE
	MAXLIN = 52
	FOR I FROM 1 THRU NUM_LINES	;"Regular lines"
		BEGIN
		IF (LINCNT .GT. MAXLIN) CALL N_PAGE
		INCR LINCNT
		INCR PRINTED_LINES
		END

	FOR I FROM 1 THRU NUM_DUC	;"Duct lines"
		BEGIN
	;;;	IF (LINCNT+3 .GT. MAXLIN) CALL N_PAGE
		IF (LINCNT+2 .GT. MAXLIN) CALL N_PAGE
		LINCNT = LINCNT + 3
		PRINTED_LINES = PRINTED_LINES + 3
		END

	FOR I FROM 1 THRU (SUM_ACC+SUM_DUC)	;Summary lines
		BEGIN
		IF (LINCNT .GT. MAXLIN) CALL N_PAGE
		INCR LINCNT
		INCR PRINTED_LINES
		END
	RETURN
;----------------------------------------------------
N_PAGE,	;;;;;;;;;;;;;;;;;;;;;;;;;;;;;;;;;;;;;;;;;;;;;
	REM = TOTAL_LINES - PRINTED_LINES
	if (rem .le. 0) return
	INCR TPAGE

	USING REM SELECT
	(.LE. END_LINES),	MAXLIN = 52
	(.GT. MID_LINES),	MAXLIN = 59
	(),			MAXLIN = 52
	ENDUSING

	LINCNT = 09		
	RETURN
;----------------------------------------------------

;;;	TPAGE = 1
;;;	REM = TOTAL_LINES - HDR_LINES
;;;	IF (REM .GT. 0) INCR TPAGE
;;;	WHILE (REM .GE. END_LINES)
;;;		BEGIN
;;;		INCR TPAGE
;;;		REM = REM - MID_LINES
;;;		END
;;;
;;;	RETURN
;-----------------------------------------------------

CLEAR_SUM_ARRAYS,	;;;;;;;;;;;;;;;;;;;;;;;;;;;;;;;;;;;;;;
			;;; CLEAR SACCRC ARRAY & SDUCRC ARRAY
			;;;;;;;;;;;;;;;;;;;;;;;;;;;;;;;;;;;;;;
	ACCREC =
	ACCQTY =
	FOR I FROM 1 THRU MAXACC SACCRC(I) = ACCREC
	DUCREC =
	DUCCFG =
	FOR I FROM 1 THRU MAXDUC	SDUCRC(I) = DUCREC

	RETURN
;-----------------------------------------------------
NXTPAG,	;;;;;;;;;;;;;;;;;;;;;;;;;;;;;;;;;;;;;;;;;;;
	REM = TOTAL_LINES - PRINTED_LINES
	if (rem .le. 0) return
	CALL PAGE_FEED
	USING REM SELECT
	(.LE. END_LINES),	BEGIN
				MAXLIN = 52
				VL = 88
				END
	(.GT. MID_LINES),	BEGIN
			;;;	MAXLIN = 60
				MAXLIN = 59
				VL = 102
		XCALL HP (14,hpFONT,hp10CPI+hpBOLD)
		XCALL HP (14, hpPOS,59,1, hpHLINE,168)	;
		XCALL HP (14, hpPOS,60,63, hpHLINE,24)	;
		PLINE(1,12) = "Continued"
		XCALL HP (14,hpPOS,61,64,0,PLINE(1,12))
		XCALL HP (14, hpPOS,62,63, hpHLINE,24)	;
		XCALL HP (14, hpPOS,60,63, hpVLINE,4)	;
		XCALL HP (14, hpPOS,60,75, hpVLINE,4)	;
				END
	(),			BEGIN		;2ND LAST & LAST PAGES
				MAXLIN = 52
				VL = 88
		XCALL HP (14,hpFONT,hp10CPI+hpBOLD)
		XCALL HP (14, hpPOS,52,1, hpHLINE,168)	;
		XCALL HP (14, hpPOS,58,63, hpHLINE,24)	;
		PLINE(1,12) = "Continued"
		XCALL HP (14,hpPOS,59,64,0,PLINE(1,12))
		XCALL HP (14, hpPOS,60,63, hpHLINE,24)	;
		XCALL HP (14, hpPOS,58,63, hpVLINE,4)	;
		XCALL HP (14, hpPOS,58,75, hpVLINE,4)	;
			;;;	MAXLIN = REM + 8
			;;;	VL = REM*2 - 2
				END
	ENDUSING


	LINCNT = 09		
	LROW = 6
	CALL INV_HEADER
	CALL BODY_HEADER
	RETURN
;-------------------------------------------------------

INV_HEADER,
	XCALL HP (14,hpFONT,hp8CPI+hpBOLD)
	IF (IS_CMEMO)
	THEN	XCALL HP (14,hpPOS,1,24,0, "C R E D I T   M E M O")
	ELSE	XCALL HP (14,hpPOS,1,24,0, "I N V O I C E")

	XCALL HP (14, hpPOS,1,1,0, "SHEET")
	XCALL HP (14, hpPOS,2,1,0, "METAL")
	XCALL HP (14, hpPOS,3,1,0, "CONNECTORS, INC.")

	XCALL HP (14,hpFONT,hp10CPI+hpBOLD)
	ENTRY(1,6) = OORDNO,'ZZZZZX'
	XCALL HP (14, hpPOS,1,65,0,ENTRY(1,6))
	INCR PAGOF
	A_PAGOF = PAGOF,'ZZX'
	A_TPAGE = TPAGE,'ZZX' [LEFT]
	XCALL HP (14,hpPOS,2,64,0,PAGE_OF)
	RETURN
;------------------------------------------------------------------------

BODY_HEADER,	;;;;;;;;;;;;;;;;;;;;;;;;;;;;;;;;;;;;;;;
	XCALL HP (14,hpFONT,hp10CPI+hpMEDIUM)
	XCALL HP (14, hpPOS,LROW,0, hpHLINE,168)	;

	XCALL HP (14,hpFONT,hp12CPI+hpBOLD)
	PLINE = '  QTY     QTY'
	INCR LROW
	XCALL HP (14,hpPOS,LROW,0,0,PLINE(1,%TRIM(PLINE)) )

;;;	PLINE = 'ORDERED SHIPPED      ITEM NO.              DESCRIPTION
	PLINE = 'ORDERED SHIPPED    ITEM NUMBER             DESCRIPTION
&             UNIT PRICE  UM    EXT PRICE'
	INCR LROW
	XCALL HP (14,hpPOS,LROW,0,0,PLINE(1,%TRIM(PLINE)) )
	CLEAR PLINE

	XCALL HP (14,hpFONT,hp10CPI+hpMEDIUM)
	XCALL HP (14, hpPOS,LROW,0, hpHLINE,168)	;

	XCALL HP (14,hpFONT,hp12CPI+hpMEDIUM)
	XCALL HP (14, hpPOS,LROW,7, hpVLINE,VL)	;
	XCALL HP (14, hpPOS,LROW,17, hpVLINE,VL)	;
	XCALL HP (14, hpPOS,LROW,33, hpVLINE,VL)	;
	XCALL HP (14, hpPOS,LROW,66, hpVLINE,VL)	;
	XCALL HP (14, hpPOS,LROW,79, hpVLINE,VL)	;
	XCALL HP (14, hpPOS,LROW,82, hpVLINE,VL)	;
	RETURN

;-----------------------------------------------------

OPENS,	;;;;;;;;;;;;;;;;;;;;;;;;;;;;;;;;;;;;;;;;;;;;
	CLEAR OPNOK

	SWITCH = 5
	XCALL FILES (1,'I',001,SWITCH)
	IF (SWITCH .EQ. 9) RETURN
	CHN001 = 1

	XCALL FILES (2,'I', 002, SWITCH)
	IF (SWITCH .EQ. 9) RETURN
	CHN002 = 2

	XCALL FILES (4,'SU',44,SWITCH)		;FILE # 44 -- ORDHDR FILE
	IF (SWITCH .EQ. 9) RETURN
	CHN044 = 4

	XCALL FILES (5,'SU',45,SWITCH)
	IF (SWITCH .EQ. 9) RETURN
	CHN045 = 5

	XCALL FILES (6,'SU',175,SWITCH)
	IF (SWITCH .EQ. 9) RETURN
	CHN175 = 6

;;;	XCALL FILES (7,'I',68,SWITCH)		;FILE # 68 -- TMPIDX FILE
;;;	IF (SWITCH .EQ. 9) RETURN
	XCALL FFILE (44, REDFIL, CLCTL)
	REDFIL(5,14) = 'INVOIC.WRK'
	OPEN (7, I, REDFIL)
	CHN068 = 7

	XCALL FILES (8,'I',170, SWITCH)
	IF (SWITCH .EQ. 9) RETURN
	CHN170 = 8

	XCALL FILES (9,'SI',182,SWITCH)
	IF (SWITCH .EQ. 9) RETURN
	CHN182 = 9

	XCALL FILES (12, 'I', 54, SWITCH)
	IF (SWITCH .EQ. 9) RETURN
	CHN054 = 12

	LOKCTL = 1
	XCALL IO (1,CUSMAS,1,READ,LOKCTL)
	SAV001 = ORG001

	LOKCTL = 1
	XCALL IO (8,ARTCTL,1,READ,LOKCTL)
	ORGART = ORG170

	OPNOK = 1
	RETURN
;-----------------------------------------------

CLOSE,	;;;;;;;;;;;;;;;;;;;;;;;;;;;;;
	IF (CHN001) CLOSE CHN001
	IF (CHN002) CLOSE CHN002
	IF (CHN044) CLOSE CHN044
	IF (CHN045) CLOSE CHN045
	IF (CHN068) CLOSE CHN068
	IF (CHN175) CLOSE CHN175
	IF (CHN054) CLOSE CHN054
	IF (CHN170) CLOSE CHN170
	IF (CHN182) CLOSE CHN182

	RETURN
;-----------------------------------------------

DIS_CALC,	;;;;;;;;;;;;;;;;;;;;;;;;;;;;;;;;
	RETURN
;-----------------------------------------------

END

